## components/peri/Kconfig
```kconfig
menu "Peripheral Drivers"

    menu "TMB12A05 Buzzer"

        config PERI_TMB12A05_GPIO_NUM
            int "Buzzer GPIO number"
            default 3
            range 0 48
            help
                GPIO number used to control the TMB12A05 active buzzer.
                This must be a valid output-capable GPIO on your ESP32 variant
                and match the board wiring.

        config PERI_TMB12A05_ACTIVE_HIGH
            bool "Active-high control"
            default y
            help
                If enabled, driving the GPIO high turns the buzzer on.
                If disabled, driving the GPIO low turns the buzzer on (active-low).

    endmenu

endmenu
```

## components/utility/Kconfig
```kconfig
menu "Logger"

config LOGGER_ENABLE
    bool "Enable logger"
    default y

config LOGGER_LEVEL
    int "Logger level (0=DEBUG,1=INFO,2=WARN,3=ERROR)"
    range 0 3
    default 0
    depends on LOGGER_ENABLE

config LOGGER_TAG
    string "Logger tag"
    default "APP"
    depends on LOGGER_ENABLE

endmenu
```

## main/Kconfig.projbuild
```kconfig
menu "App Config"

config DEV_MODE
    bool "Enable developer mode"
    default y
    help
      When enabled, the firmware will keep the web server running even after
      Wi-Fi is configured, and may enable other dev-only features.

config SENTINEL_ENABLE_OFF_SLEEP_GATE
    bool "Pause periodic monitoring and enter WoM light sleep when patrol RMS is low"
    default y
    help
      When enabled, patrol RMS below the configured threshold for several
      consecutive patrol windows will pause periodic monitoring, arm LIS2DH12
      WoM wakeup, and enter light sleep until motion wakes the device.

config SENTINEL_OFF_RMS_THRESHOLD_MM_S
    int "Patrol RMS threshold for OFF gating (mm/s)"
    range 0 100
    default 1
    depends on SENTINEL_ENABLE_OFF_SLEEP_GATE
    help
      If the maximum RMS across X/Y/Z during patrol is below this value, the
      sample is considered a low-energy OFF candidate.

config SENTINEL_OFF_CONFIRM_COUNT
    int "Consecutive low-RMS patrol windows required before sleep"
    range 1 10
    default 2
    depends on SENTINEL_ENABLE_OFF_SLEEP_GATE
    help
      Number of consecutive patrol RMS windows below threshold required before
      periodic tasks are paused and the device enters WoM light sleep.

config SENTINEL_BOOT_AP_CONNECT_WINDOW_SEC
    int "Boot AP connect window (seconds)"
    range 1 300
    default 10
    help
      Time window after boot during which the device waits for a client to
      connect to the configuration AP before continuing into the main program.

config SENTINEL_BOOT_AP_CONFIG_WINDOW_SEC
    int "Boot AP configuration window after client connect (seconds)"
    range 1 600
    default 60
    help
      If a client connects to the configuration AP during boot, the device
      waits this long for configuration submission before continuing into the
      main program automatically.

config SENTINEL_DIRECT_REPORT_PATROL_THRESHOLD_MIN
    int "Patrol interval threshold for direct normal reporting (minutes)"
    range 1 1440
    default 60
    help
      When patrol interval is greater than or equal to this value, normal
      patrol RMS reports bypass batch accumulation and flush immediately.

config SENTINEL_SLEEP_PRE_FLUSH_TIMEOUT_SEC
    int "Timeout for dispatcher flush before OFF sleep (seconds)"
    range 1 300
    default 30
    help
      Before entering WoM light sleep after low-RMS OFF detection, the device
      waits up to this many seconds for queued reports to flush successfully.

config SENTINEL_NETWORK_BRINGUP_TIMEOUT_SEC
    int "Timeout for network and MQTT bring-up before sending (seconds)"
    range 1 300
    default 90
    help
      When dispatcher needs to send but MQTT is offline, it will bring up WiFi
      STA or 4G according to user configuration and wait up to this many
      seconds for MQTT to become ready.

config SENTINEL_CAP_READY_DELTA_MV
    int "Super-cap ready delta threshold (mV)"
    range 10 1000
    default 100
    help
      The super-cap is considered ready when battery_voltage_mv minus
      supercap_voltage_mv is less than or equal to this threshold.

config SENTINEL_CAP_CHARGE_PWM_FREQ_HZ
    int "Super-cap charge PWM frequency (Hz)"
    range 1000 50000
    default 5000
    help
      PWM frequency used on GPIO_CHARGE while charging the super-cap.

config SENTINEL_CAP_CHARGE_RAMP_MS
    int "Super-cap charge ramp duration (ms)"
    range 100 10000
    default 3000
    help
      During this time window the charge PWM duty rises linearly from 0 to 50%.

config SENTINEL_CAP_CHARGE_HOLD_MS
    int "Super-cap charge hold duration after ramp (ms)"
    range 0 10000
    default 2000
    help
      After the ramp phase, charge PWM stays at 50% for this long before the
      firmware starts checking the voltage delta.

config SENTINEL_CAP_CHARGE_POLL_MS
    int "Super-cap charge poll interval (ms)"
    range 50 5000
    default 200
    help
      Voltage-delta polling interval after the initial 5-second charge profile.

config SENTINEL_CAP_CHARGE_TIMEOUT_SEC
    int "Super-cap charge timeout (seconds)"
    range 5 300
    default 60
    help
      Maximum allowed total charging time before the boot energy guard fails.

config SENTINEL_SENSOR_POWER_SETTLE_MS
    int "IIS3DWB power settle time (ms)"
    range 1 1000
    default 20
    help
      Wait time after enabling the IIS3DWB power rail before SPI access.

config SENTINEL_4G_POWER_SETTLE_MS
    int "4G main power settle time (ms)"
    range 1 5000
    default 500
    help
      Wait time after enabling the 4G main power rail before modem probing.

endmenu
```
